## firmware/apocalypse-comm/main/Kconfig.projbuild
```kconfig
menu "Apocalypse Communicator - Wiring"

    choice BOARD
        prompt "Board"
        default BOARD_ESP32 if IDF_TARGET_ESP32
        default BOARD_XIAO
        help
            Picks sensible pin defaults. Every pin can still be changed below.
        config BOARD_XIAO
            bool "Seeed XIAO ESP32S3 + Wio-SX1262 kit (compact handheld)"
            depends on IDF_TARGET_ESP32S3
        config BOARD_DEVKIT
            bool "Generic ESP32-S3 DevKit (many pins)"
            depends on IDF_TARGET_ESP32S3
        config BOARD_ESP32
            bool "ESP32-WROOM-32 DevKit (classic ESP32)"
            depends on IDF_TARGET_ESP32
    endchoice

    comment "Any part can be left out: set its pin to -1, or just don't connect it."

    menu "Display (I2C OLED)"
        config PIN_I2C_SDA
            int "I2C SDA pin"
            default 21 if BOARD_ESP32
            default 5 if BOARD_XIAO
            default 8
        config PIN_I2C_SCL
            int "I2C SCL pin"
            default 22 if BOARD_ESP32
            default 6 if BOARD_XIAO
            default 9
        config OLED_ADDR
            hex "OLED I2C address"
            default 0x3C
        choice OLED_CHIP
            prompt "OLED controller"
            default OLED_SSD1306
            config OLED_SSD1306
                bool "SSD1306 / SSD1315 (most 0.96 inch, Seeed Grove OLED)"
            config OLED_SH1106
                bool "SH1106 (most 1.3 inch displays)"
        endchoice
    endmenu

    menu "Buttons"
        config BUTTONS_LADDER
            bool "All buttons on ONE analog pin (resistor ladder, saves pins)"
            default y if BOARD_XIAO || BOARD_ESP32
            default n
        config PIN_BTN_LADDER
            int "Ladder analog pin (ADC1: S3 GPIO1-10, ESP32 GPIO32-39)"
            default 36 if BOARD_ESP32
            default 1
            depends on BUTTONS_LADDER
        config LADDER_PULLUP_OHM
            int "Ladder pull-up resistor (pin to 3V3), ohms"
            default 10000
            depends on BUTTONS_LADDER
        config PIN_BTN_UP
            int "UP (button to GND)"
            default 32 if BOARD_ESP32
            default 4
            depends on !BUTTONS_LADDER
        config PIN_BTN_DOWN
            int "DOWN"
            default 33 if BOARD_ESP32
            default 5
            depends on !BUTTONS_LADDER
        config PIN_BTN_LEFT
            int "LEFT"
            default 16 if BOARD_ESP32
            default 6
            depends on !BUTTONS_LADDER
        config PIN_BTN_RIGHT
            int "RIGHT"
            default 17 if BOARD_ESP32
            default 7
            depends on !BUTTONS_LADDER
        config PIN_BTN_OK
            int "OK"
            default 13 if BOARD_ESP32
            default 15
            depends on !BUTTONS_LADDER
        config PIN_BTN_BACK
            int "BACK"
            default 15 if BOARD_ESP32
            default 16
            depends on !BUTTONS_LADDER
        config PIN_BTN_MORSE
            int "MORSE key"
            default 12 if BOARD_ESP32
            default 17
            depends on !BUTTONS_LADDER
    endmenu

    menu "LEDs"
        comment "A missing LED role falls back to any LED that exists."
        config PIN_LED_RED
            int "Red (alert / SOS), -1 = none"
            default 32 if BOARD_ESP32
            default -1 if BOARD_XIAO
            default 38
        config PIN_LED_GREEN
            int "Green (receive / status), -1 = none"
            default 2 if BOARD_ESP32
            default 21 if BOARD_XIAO
            default 39
        config PIN_LED_BLUE
            int "Blue (transmit), -1 = none"
            default 33 if BOARD_ESP32
            default -1 if BOARD_XIAO
            default 40
        config PIN_LED_WHITE
            int "White (signal light), -1 = none"
            default 16 if BOARD_ESP32
            default -1 if BOARD_XIAO
            default 41
        config LED_ACTIVE_LOW
            bool "LEDs light when pin is LOW (XIAO built-in LED)"
            default y if BOARD_XIAO
            default n
    endmenu

    menu "Audio"
        config AUDIO_SHARED_I2S
            bool "Speaker amp and mic share BCLK + WS wires (saves 2 pins)"
            default y if BOARD_XIAO
            default n
        config PIN_SPK_BCLK
            int "BCLK (amp BCLK, and mic SCK if shared)"
            default 26 if BOARD_ESP32
            default 4 if BOARD_XIAO
            default 10
        config PIN_SPK_WS
            int "WS / LRC (amp LRC, and mic WS if shared)"
            default 25 if BOARD_ESP32
            default 43 if BOARD_XIAO
            default 11
        config PIN_SPK_DIN
            int "Amp DIN, -1 = no speaker"
            default 27 if BOARD_ESP32
            default 44 if BOARD_XIAO
            default 12
        config PIN_MIC_SD
            int "Mic SD (data), -1 = no mic"
            default 34 if BOARD_ESP32
            default 3 if BOARD_XIAO
            default 18
        config PIN_MIC_SCK
            int "Mic SCK"
            default 14 if BOARD_ESP32
            default 13
            depends on !AUDIO_SHARED_I2S
        config PIN_MIC_WS
            int "Mic WS"
            default 13 if BOARD_ESP32
            default 14
            depends on !AUDIO_SHARED_I2S
    endmenu

    menu "Battery"
        config BATTERY_ADC_ENABLE
            bool "Measure battery voltage"
            default y
        config PIN_BATTERY_ADC
            int "Battery divider pin (ADC1: S3 GPIO1-10, ESP32 GPIO32-39)"
            default 39 if BOARD_ESP32
            default 2 if BOARD_XIAO
            default 1
            depends on BATTERY_ADC_ENABLE
        config BATTERY_DIVIDER_X100
            int "Divider ratio x100 (two equal resistors = 200)"
            default 200
            depends on BATTERY_ADC_ENABLE
    endmenu

    menu "LoRa radio"
        config LORA_ENABLE
            bool "Use a LoRa module if one is connected (safe if missing)"
            default y if BOARD_XIAO || BOARD_ESP32
            default n
        choice LORA_CHIP
            prompt "LoRa chip"
            depends on LORA_ENABLE
            default LORA_SX1262 if BOARD_XIAO
            default LORA_SX1276
            config LORA_SX1262
                bool "SX1262 (Seeed Wio-SX1262, Heltec, RAK)"
            config LORA_SX1276
                bool "SX1276 / SX1278 / RFM95 / Ra-02"
        endchoice
        config LORA_FREQ_KHZ
            int "Frequency kHz (433175, 868100 or 915000 - CHECK LOCAL LAW)"
            default 868100 if LORA_SX1262
            default 433175
            depends on LORA_ENABLE
        config LORA_TX_POWER_DBM
            int "Transmit power dBm"
            range 2 22
            default 20 if LORA_SX1262
            default 17
            depends on LORA_ENABLE
        config PIN_LORA_SCK
            int "SCK"
            default 18 if BOARD_ESP32
            default 7 if BOARD_XIAO
            default 21
            depends on LORA_ENABLE
        config PIN_LORA_MISO
            int "MISO"
            default 19 if BOARD_ESP32
            default 8 if BOARD_XIAO
            default 47
            depends on LORA_ENABLE
        config PIN_LORA_MOSI
            int "MOSI"
            default 23 if BOARD_ESP32
            default 9 if BOARD_XIAO
            default 48
            depends on LORA_ENABLE
        config PIN_LORA_NSS
            int "NSS / CS"
            default 5 if BOARD_ESP32
            default 41 if BOARD_XIAO
            default 42
            depends on LORA_ENABLE
        config PIN_LORA_RST
            int "RESET"
            default 4 if BOARD_ESP32
            default 42 if BOARD_XIAO
            default 2
            depends on LORA_ENABLE
        config PIN_LORA_BUSY
            int "BUSY (SX1262 only)"
            default 35 if BOARD_ESP32
            default 40 if BOARD_XIAO
            default 3
            depends on LORA_SX1262
        config PIN_LORA_DIO1
            int "DIO1 (SX1262 only, -1 = poll over SPI)"
            default 39 if BOARD_XIAO
            default -1
            depends on LORA_SX1262
        config PIN_LORA_RXEN
            int "RX enable / antenna switch (SX1262 only, -1 = none)"
            default 38 if BOARD_XIAO
            default -1
            depends on LORA_SX1262
        config LORA_TCXO
            bool "Module has a TCXO powered from DIO3 (Wio-SX1262: yes)"
            default y
            depends on LORA_SX1262
    endmenu

endmenu
```
